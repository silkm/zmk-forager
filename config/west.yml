## config/west.yml
```yaml
manifest:
  defaults:
    revision: main
  remotes:
    - name: zmkfirmware
      url-base: https://github.com/zmkfirmware
    - name: carrefinho
      url-base: https://github.com/carrefinho
    - name: caksoylar
      url-base: https://github.com/caksoylar
  projects:
    - name: zmk
      remote: zmkfirmware
      import: app/west.yml
    - name: forager-zmk-module
      remote: carrefinho
      # zephyr-4-1-update branch head; switch to main once it's merged upstream
      revision: 6c5e0ce69a9c8ce2d9f68b4b609ae99a1b468749
    - name: zmk-rgbled-widget
      remote: caksoylar
      revision: main
  self:
    path: config
```
